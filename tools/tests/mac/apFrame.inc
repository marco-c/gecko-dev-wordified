>
[
B
[
]
/
/
apFrame
.
inc
[
]
/
/
contains
globals
and
window
definitions
for
AppRunner
[
]
const
wMainWindow
=
Apprunner
[
]
INT
iBitmapWait
=
120
[
]
INT
iBaselineCRC
[
]
STRING
fileName
[
]
STRING
sBitmapFile
[
]
STRING
sData
[
]
STRING
sURL
[
]
RECT
rloc
rMoz
[
]
RECT
rpole
=
{
118
458
75
15
}
[
]
RECT
rCenter
=
{
100
100
50
50
}
[
]
RECT
rThrobber
[
]
RECT
rSidebar
[
]
POINT
pHome
=
{
42
61
}
[
]
POINT
pLocation
=
{
219
18
}
[
]
POINT
pPrev
=
{
293
375
}
[
]
POINT
pNext
=
{
337
375
}
[
]
STRING
sUserName
=
"
iqasmoketest
"
/
/
change
this
to
create
your
own
profile
[
]
STRING
sMailServer
=
"
polyglot
.
mcom
.
com
"
/
/
change
this
to
the
name
of
your
mail
server
[
]
STRING
sHomeWindow
=
"
NOT
SET
"
/
/
name
of
the
expected
window
[
]
STRING
sStartupWindow
/
/
name
of
the
expected
window
[
]
STRING
sWindowName
[
]
STRING
sWin
[
]
[
]
BOOLEAN
bDebug
=
false
[
]
BOOLEAN
bGrippyOpen
=
true
[
]
[
]
const
INT
E_WIN_NOT_FOUND
=
-
1
[
]
const
INT
E_WIN_NOT_OPEN
=
-
2
[
]
const
INT
E_EMPTY_STRING
=
-
3
[
]
const
INT
E_DIRECTORY
=
-
4
[
]
const
INT
E_BACK_BUTTON_FAILS
=
-
5
[
]
const
INT
E_FORWARD_BUTTON_FAILS
=
-
6
[
]
[
-
]
window
MainWin
Apprunner
[
]
tag
"
apprunner
"
[
]
[
]
/
/
The
working
directory
of
the
application
when
it
is
invoked
[
]
const
sDir
=
ReadMozillaHome
(
)
/
/
home
directory
of
seamonkey
executable
(
Apprunner
)
[
]
[
]
/
/
The
command
line
used
to
invoke
the
application
[
]
const
sCmdLine
=
"
apprunner
"
[
]
[
]
/
/
The
first
window
to
appear
when
the
application
is
invoked
[
]
/
/
const
wStartup
=
MozillaQASmokeTests
[
]
[
]
/
/
The
list
of
windows
the
recovery
system
is
to
leave
open
[
]
/
/
const
lwLeaveOpen
=
{
?
}
[
-
]
Invoke
(
)
[
]
RECT
rWin
[
]
ANYTYPE
aPrev
[
]
INT
iSleep
=
0
[
]
Agent
.
SetOption
(
OPT_WINDOW_TIMEOUT
iBitmapWait
)
[
]
Agent
.
SetOption
(
OPT_VERIFY_EXPOSED
false
)
[
]
Agent
.
SetOption
(
OPT_VERIFY_UNIQUE
false
)
[
]
Agent
.
SetOption
(
OPT_VERIFY_ENABLED
false
)
[
]
Agent
.
SetOption
(
OPT_BITMAP_MATCH_COUNT
1
)
[
]
Agent
.
SetOption
(
OPT_BITMAP_MATCH_INTERVAL
.
1
)
[
]
Agent
.
SetOption
(
OPT_BITMAP_MATCH_TIMEOUT
iBitmapWait
)
[
-
]
do
[
]
derived
:
:
Invoke
(
)
[
+
]
except
[
-
]
do
[
]
Print
(
"
*
*
*
Warning
:
Apprunner
failed
to
launch
the
first
time
.
"
)
[
]
Print
(
"
*
*
*
Trying
again
.
.
.
"
)
[
]
derived
:
:
Invoke
(
)
[
-
]
except
[
]
raise
1
"
Apprunner
failed
to
launch
the
second
time
:
testing
cannot
continue
"
[
]
aPrev
=
Agent
.
SetOption
(
OPT_WINDOW_TIMEOUT
120
.
0
)
[
]
Agent
.
SetOption
(
OPT_WINDOW_TIMEOUT
aPrev
)
[
]
Mozilla
.
Move
(
0
0
)
[
-
]
if
(
Mozilla
.
CustomWin
(
"
[
24
.
2
]
#
3
"
)
.
Exists
(
)
)
[
]
/
/
the
following
lines
attempt
to
close
the
sidebar
so
testing
can
proceed
.
[
]
/
/
unfortunately
QAP
can
'
t
see
the
sidebar
.
Hopefully
this
will
do
no
harm
[
]
rMoz
=
Mozilla
.
GetRect
(
)
[
]
rSidebar
=
Mozilla
.
CustomWin
(
"
[
24
.
2
]
#
1
"
)
.
GetRect
(
)
[
]
Mozilla
.
Click
(
1
rSidebar
.
xPos
+
50
pHome
.
y
)
/
/
click
on
the
home
button
in
the
right
-
hand
frame
[
]
sleep
(
5
)
[
]
Mozilla
.
Click
(
1
rSidebar
.
xPos
+
20
rMoz
.
ySize
/
2
)
/
/
click
on
the
grippy
closing
the
sidebar
[
]
bGrippyOpen
=
false
[
-
]
else
[
]
bGrippyOpen
=
false
[
-
]
if
(
sHomeWindow
=
=
"
NOT
SET
"
)
[
]
Mozilla
.
Home
.
Click
(
)
[
]
sHomeWindow
=
Mozilla
.
GetCaption
(
)
[
+
]
/
/
do
[
]
/
/
Mozilla
.
Size
(
640
480
)
[
+
]
/
/
except
[
]
/
/
Print
(
"
*
*
*
Warning
:
QAP
claims
it
can
'
t
resize
mozilla
window
"
)
[
]
rMoz
=
Mozilla
.
GetRect
(
)
[
]
rThrobber
=
{
rMoz
.
xSize
-
50
30
30
30
}
[
-
]
while
(
StrPos
(
"
Mozilla
"
sHomeWindow
)
=
=
0
)
[
-
]
if
(
StrPos
(
"
CreateProfile
Wizard
"
sWin
)
>
0
)
[
]
CreateProfileWizard
.
Setup
(
)
[
]
derived
:
:
Invoke
(
)
[
]
sleep
(
1
)
[
]
sWindowName
=
Mozilla
.
GetCaption
(
)
[
]
iSleep
+
+
[
-
]
if
(
iSleep
>
60
)
[
-
]
if
(
StrPos
(
"
_nameless_
"
sWindowName
)
>
0
)
[
]
raise
1
"
apprunner
opened
a
nameless
window
and
hung
:
testing
cannot
continue
"
[
]
Mozilla
.
Back
.
Click
(
)
/
/
attempt
to
recover
by
going
back
to
previous
window
[
]
sleep
(
5
)
[
-
]
if
(
StrPos
(
"
Mozilla
"
sWindowName
)
=
=
0
)
[
]
raise
1
"
application
failed
to
open
window
{
sStartupWindow
}
:
testing
cannot
continue
"
[
]
[
]
Mozilla
.
Move
(
0
0
)
[
]
sleep
(
1
)
[
-
]
SetActive
(
)
[
-
]
do
[
]
derived
:
:
SetActive
(
)
[
-
]
except
[
]
Print
(
"
*
*
*
Warning
:
Apprunner
did
not
exit
cleanly
"
)
[
-
]
if
(
sHomeWindow
=
=
"
NOT
SET
"
)
[
]
Mozilla
.
Home
.
Click
(
)
[
]
sHomeWindow
=
Mozilla
.
GetCaption
(
)
[
-
]
do
[
]
Agent
.
SetOption
(
OPT_WINDOW_SIZE_TOLERANCE
10
)
[
]
Mozilla
.
Size
(
802
627
)
[
-
]
except
[
]
Print
(
"
QAP
says
it
can
'
t
size
Mozilla
"
)
[
-
]
do
[
]
Mozilla
.
Move
(
0
0
)
[
-
]
except
[
]
Print
(
"
QAP
says
it
can
'
t
move
Mozilla
"
)
[
+
]
InvokeSimple
(
)
[
]
derived
:
:
Invoke
(
)
[
-
]
/
/
if
Apprunner
.
Exists
(
)
[
]
/
/
Apprunner
.
SetActive
(
)
[
-
]
/
/
else
[
]
/
/
derived
:
:
Invoke
(
)
[
]
/
/
if
ProfileManager
.
Exists
(
)
[
]
/
/
ProfileManager
.
SetActive
(
)
[
]
/
/
ProfileManager
.
ProfileName1
.
Select
(
"
test
"
)
[
]
/
/
ProfileManager
.
StartCommunicator
.
Click
(
)
[
]
/
/
sleep
(
3
)
[
+
]
Menu
File
[
]
tag
"
File
"
[
+
]
MenuItem
NewBrowserWindow
[
]
tag
"
New
Browser
Window
"
[
+
]
MenuItem
New
[
]
tag
"
New
"
[
+
]
MenuItem
OpenWebLocation
[
]
tag
"
Open
Web
Location
"
[
+
]
MenuItem
OpenFile
[
]
tag
"
Open
File
"
[
+
]
MenuItem
Close
[
]
tag
"
Close
"
[
+
]
MenuItem
SendPage
[
]
tag
"
Send
Page
"
[
+
]
MenuItem
EditPage
[
]
tag
"
Edit
Page
"
[
+
]
MenuItem
Offline
[
]
tag
"
Offline
"
[
+
]
MenuItem
PrintSetup
[
]
tag
"
Print
Setup
"
[
+
]
MenuItem
PrintPreview
[
]
tag
"
Print
Preview
"
[
+
]
MenuItem
Print
[
]
tag
"
Print
"
[
+
]
MenuItem
Quit
[
]
tag
"
Quit
"
[
+
]
Menu
Edit
[
]
tag
"
Edit
"
[
+
]
MenuItem
Undo
[
]
tag
"
Undo
"
[
+
]
MenuItem
Redo
[
]
tag
"
Redo
"
[
+
]
MenuItem
Cut
[
]
tag
"
Cut
"
[
+
]
MenuItem
Copy
[
]
tag
"
Copy
"
[
+
]
MenuItem
Paste
[
]
tag
"
Paste
"
[
+
]
MenuItem
Delete
[
]
tag
"
Delete
"
[
+
]
MenuItem
SelectAll
[
]
tag
"
Select
All
"
[
+
]
MenuItem
Wallet
[
]
tag
"
Wallet
"
[
+
]
MenuItem
Preferences
[
]
tag
"
Preferences
"
[
+
]
Menu
View
[
]
tag
"
View
"
[
+
]
MenuItem
Toolbars
[
]
tag
"
Toolbars
"
[
+
]
MenuItem
Sidebar
[
]
tag
"
Sidebar
"
[
+
]
MenuItem
EnlargeTextSize
[
]
tag
"
Enlarge
Text
Size
"
[
+
]
MenuItem
ReduceTextSize
[
]
tag
"
Reduce
Text
Size
"
[
+
]
MenuItem
UseStylesheet
[
]
tag
"
Use
Stylesheet
"
[
+
]
MenuItem
Reload
[
]
tag
"
Reload
"
[
+
]
MenuItem
ShowImages
[
]
tag
"
Show
Images
"
[
+
]
MenuItem
Stop
[
]
tag
"
Stop
"
[
+
]
MenuItem
PageSource
[
]
tag
"
Page
Source
"
[
+
]
MenuItem
PageInfo
[
]
tag
"
Page
Info
"
[
+
]
MenuItem
Translate
[
]
tag
"
Translate
"
[
+
]
MenuItem
CharacterSet
[
]
tag
"
Character
Set
"
[
+
]
Menu
Search
[
]
tag
"
Search
"
[
+
]
Menu
Go
[
]
tag
"
Go
"
[
+
]
Menu
Bookmarks
[
]
tag
"
Bookmarks
"
[
+
]
Menu
Tasks
[
]
tag
"
Tasks
"
[
+
]
MenuItem
Navigator
[
]
tag
"
Navigator
"
[
+
]
MenuItem
Messenger
[
]
tag
"
Messenger
"
[
+
]
MenuItem
Editor
[
]
tag
"
Editor
"
[
+
]
MenuItem
PlaintextEditor
[
]
tag
"
Plaintext
Editor
"
[
+
]
MenuItem
AddressBook
[
]
tag
"
Address
Book
"
[
+
]
MenuItem
Newsgroups
[
]
tag
"
Newsgroups
"
[
+
]
MenuItem
Tools
[
]
tag
"
Tools
"
[
+
]
MenuItem
Mozilla
[
]
tag
"
Mozilla
"
[
+
]
MenuItem
A
[
]
tag
"
a
"
[
+
]
Menu
Debug
[
]
tag
"
Debug
"
[
+
]
Menu
QA
[
]
tag
"
QA
"
[
+
]
Menu
Help
[
]
tag
"
Help
"
[
+
]
MenuItem
AboutBalloonHelp
[
]
tag
"
About
Balloon
Help
"
[
+
]
MenuItem
MenuItem2
[
]
tag
"
-
"
[
+
]
MenuItem
ShowBalloons
[
]
tag
"
Show
Balloons
"
[
+
]
MenuItem
B
[
]
tag
"
b
"
[
+
]
MenuItem
WhatSNewIn50
[
]
tag
"
What
'
s
New
in
5
.
0
"
[
+
]
MenuItem
NewToNetscapeTutorial
[
]
tag
"
New
to
Netscape
Tutorial
"
[
+
]
MenuItem
SupportChannel
[
]
tag
"
Support
Channel
"
[
+
]
MenuItem
InternationalUsers
[
]
tag
"
International
Users
"
[
+
]
MenuItem
AboutCommunicator
[
]
tag
"
About
Communicator
"
[
+
]
window
MessageBoxClass
MessageBox
[
]
tag
"
~
ActiveApp
/
[
DialogBox
]
MessageBox
"
[
+
]
PushButton
OK
[
]
tag
"
OK
"
[
+
]
PushButton
Cancel
[
]
tag
"
Cancel
"
[
+
]
PushButton
Yes
[
]
tag
"
Yes
"
[
+
]
PushButton
No
[
]
tag
"
No
"
[
+
]
StaticText
Message
[
]
motif
tag
"
#
2
"
[
]
tag
"
#
1
"
[
+
]
/
/
window
ChildWin
Mozilla
[
]
/
/
tag
"
#
1
"
[
]
/
/
parent
Apprunner
[
]
/
/
[
-
]
/
/
InitAddress
(
)
[
]
/
/
this
.
Location
.
PressMouse
(
1
2
2
)
[
]
/
/
this
.
ReleaseMouse
(
1
2
2
)
[
]
/
/
this
.
TypeKeys
(
"
<
backspace
>
"
)
[
-
]
/
/
SetAddress
(
STRING
sURL
)
[
]
/
/
this
.
Location
.
Click
(
1
2
2
)
[
]
/
/
this
.
TypeKeys
(
sURL
+
"
<
ENTER
>
"
)
[
]
/
/
this
.
TypeKeys
(
"
<
ENTER
>
"
)
[
-
]
/
/
SetPoleBitmap
(
STRING
bitmapFile
RECT
rTest
)
[
]
/
/
this
.
CaptureBitmap
(
bitmapFile
rTest
)
[
-
]
/
/
TextField
Location
[
]
/
/
tag
"
#
1
"
[
]
/
/
[
-
]
/
/
SetText
(
STRING
sText
)
[
]
/
/
INTEGER
i
[
]
/
/
this
.
ClearText
(
)
[
]
/
/
this
.
Click
(
1
2
2
)
[
]
/
/
/
/
Mozilla
.
Location
.
PressMouse
(
1
1
1
)
[
]
/
/
/
/
Mozilla
.
Location
.
ReleaseMouse
(
1
this
.
Rect
.
xSize
-
2
this
.
Rect
.
ySize
-
2
)
[
]
/
/
Mozilla
.
TypeKeys
(
sText
)
[
-
]
/
/
ClearText
(
)
[
]
/
/
Agent
.
SetOption
(
OPT_MOUSE_DELAY
0
.
5
)
[
]
/
/
this
.
Click
(
1
2
2
)
[
]
/
/
this
.
PressMouse
(
1
2
2
)
[
]
/
/
this
.
ReleaseMouse
(
1
400
15
)
[
]
/
/
Agent
.
SetOption
(
OPT_MOUSE_DELAY
0
.
0
)
[
]
/
/
Mozilla
.
TypeKeys
(
"
<
backspace
>
"
)
[
]
/
/
[
-
]
window
ChildWin
Mozilla
[
]
tag
"
#
1
"
[
]
parent
Apprunner
[
-
]
Close
(
)
[
]
derived
:
:
Close
(
)
[
]
bGrippyOpen
=
true
[
+
]
SetActive
(
)
[
]
derived
:
:
SetActive
(
)
[
]
this
.
Size
(
802
627
)
[
]
this
.
Move
(
0
0
)
[
+
]
InitAddress
(
)
[
]
this
.
ClearText
(
)
[
-
]
ClearText
(
)
[
]
Agent
.
SetOption
(
OPT_MOUSE_DELAY
0
.
5
)
[
]
this
.
Click
(
1
pLocation
.
x
pLocation
.
y
)
[
]
this
.
TypeKeys
(
"
<
Cmd
-
a
>
"
)
[
]
this
.
TypeKeys
(
"
<
backspace
>
"
)
[
]
Agent
.
SetOption
(
OPT_MOUSE_DELAY
0
.
0
)
[
-
]
SetAddress
(
STRING
sURL
)
[
]
this
.
SetText
(
sURL
)
[
-
]
SetText
(
STRING
sURL
)
[
]
this
.
ClearText
(
)
[
]
this
.
TypeKeys
(
sURL
)
[
+
]
SetPoleBitmap
(
STRING
bitmapFile
RECT
rTest
)
[
]
this
.
CaptureBitmap
(
bitmapFile
rTest
)
[
-
]
CustomWin
Home
[
-
]
Click
(
)
[
]
Mozilla
.
Click
(
1
pHome
.
x
pHome
.
y
)
[
-
]
CustomWin
MyNetscape
[
-
]
Click
(
)
[
]
Mozilla
.
Click
(
1
pHome
.
x
+
75
pHome
.
y
)
[
+
]
CustomWin
Location
[
]
mac
tag
"
[
17
.
0
]
#
2
"
[
-
]
SetText
(
STRING
sText
)
[
]
this
.
ClearText
(
)
[
]
this
.
PressMouse
(
1
1
1
)
[
]
/
/
this
.
ReleaseMouse
(
1
this
.
Rect
.
xSize
-
2
this
.
Rect
.
ySize
-
2
)
[
]
Mozilla
.
TypeKeys
(
sText
+
"
<
enter
>
"
)
[
-
]
ClearText
(
)
[
]
this
.
PressMouse
(
1
1
1
)
[
]
this
.
ReleaseMouse
(
1
this
.
Rect
.
xSize
this
.
Rect
.
ySize
+
50
)
[
]
Mozilla
.
TypeKeys
(
"
<
backspace
>
"
)
[
+
]
CustomWin
Back
[
-
]
Click
(
)
[
]
Mozilla
.
Click
(
1
35
25
)
[
+
]
CustomWin
Forward
[
-
]
Click
(
)
[
]
Mozilla
.
Click
(
1
85
25
)
[
+
]
CustomWin
Reload
[
-
]
Click
(
)
[
]
Mozilla
.
Click
(
1
135
25
)
[
+
]
CustomWin
Stop
[
-
]
Click
(
)
[
]
Mozilla
.
Click
(
1
190
25
)
[
+
]
window
ChildWin
MozillaQASmokeTests
[
]
tag
"
#
1
"
[
]
parent
Apprunner
[
+
]
ScrollBar
ScrollBar7
[
]
tag
"
#
7
"
[
+
]
ScrollBar
ScrollBar5
[
]
tag
"
#
5
"
[
+
]
ScrollBar
ScrollBar8
[
]
tag
"
#
8
"
[
+
]
ScrollBar
ScrollBar4
[
]
tag
"
#
4
"
[
+
]
ScrollBar
ScrollBar11
[
]
tag
"
#
11
"
[
+
]
ScrollBar
ScrollBar3
[
]
tag
"
#
3
"
[
+
]
ScrollBar
ScrollBar9
[
]
tag
"
#
9
"
[
+
]
ScrollBar
ScrollBar6
[
]
tag
"
#
6
"
[
+
]
ScrollBar
ScrollBar10
[
]
tag
"
#
10
"
[
+
]
ScrollBar
ScrollBar1
[
]
tag
"
#
1
"
[
+
]
ScrollBar
ScrollBar12
[
]
tag
"
#
12
"
[
+
]
ScrollBar
ScrollBar2
[
]
tag
"
#
2
"
[
+
]
TextField
TextField1
[
]
tag
"
#
1
"
[
+
]
LIST
of
STRING
String2List
(
STRING
s
)
[
]
STRING
sTemp
=
s
[
]
STRING
sItem
[
]
INT
iPos
[
]
BOOLEAN
bDone
=
false
[
]
LIST
of
STRING
lsList
[
-
]
if
(
Len
(
s
)
=
=
0
)
[
]
raise
E_EMPTY_STRING
"
*
*
*
Error
:
String
is
Empty
"
[
-
]
while
(
bDone
=
=
false
)
[
]
iPos
=
StrPos
(
"
:
"
sTemp
)
[
-
]
if
(
iPos
>
0
)
[
]
sItem
=
SubStr
(
sTemp
1
iPos
-
1
)
[
]
ListAppend
(
lsList
sItem
)
[
]
sTemp
=
SubStr
(
sTemp
iPos
+
1
)
[
-
]
else
if
(
iPos
=
=
0
)
[
-
]
if
(
Len
(
sTemp
)
=
=
0
)
[
]
raise
E_DIRECTORY
"
*
*
*
Error
:
String
is
a
directory
not
a
file
"
[
-
]
else
[
]
ListAppend
(
lsList
sTemp
)
[
]
bDone
=
true
[
]
return
lsList
[
+
]
window
DialogBox
OpenFileDialog
[
]
tag
"
Open
"
[
]
parent
Apprunner
[
-
]
OpenFile
(
LIST
OF
STRING
ls
)
[
]
INT
i
[
]
this
.
TypeKeys
(
"
<
cmd
-
d
>
"
)
[
-
]
for
i
=
1
to
ListCount
(
ls
)
[
]
this
.
TypeKeys
(
ls
[
i
]
)
[
]
this
.
TypeKeys
(
"
<
enter
>
"
)
[
+
]
CustomWin
OpenFile2
[
]
mac
tag
"
[
23
.
0
]
Open
File
[
2
]
"
[
+
]
CustomWin
OpenFile1
[
]
mac
tag
"
[
23
.
0
]
Open
File
[
1
]
"
[
+
]
CustomWin
N1601
[
]
mac
tag
"
[
16
.
0
]
#
1
"
[
+
]
CustomWin
OpenFile1
[
]
mac
tag
"
[
2
.
1
]
Open
File
"
[
+
]
StaticText
OpenFileText
[
]
tag
"
Open
File
"
[
+
]
CustomWin
OpenFile2
[
]
mac
tag
"
[
9
.
0
]
Open
File
"
[
+
]
CustomWin
N203
[
]
mac
tag
"
[
2
.
0
]
#
3
"
[
+
]
CustomWin
N202
[
]
mac
tag
"
[
2
.
0
]
#
2
"
[
+
]
CustomWin
N201
[
]
mac
tag
"
[
2
.
0
]
#
1
"
[
+
]
CustomWin
N211
[
]
mac
tag
"
[
2
.
1
]
#
1
"
[
+
]
CustomWin
N2301
[
]
mac
tag
"
[
23
.
0
]
#
1
"
[
+
]
CustomWin
N213
[
]
mac
tag
"
[
2
.
1
]
#
3
"
[
+
]
CustomWin
N212
[
]
mac
tag
"
[
2
.
1
]
#
2
"
[
+
]
CustomWin
N2511
[
]
mac
tag
"
[
25
.
1
]
#
1
"
[
+
]
CustomWin
N2401
[
]
mac
tag
"
[
24
.
0
]
#
1
"
[
+
]
CustomWin
OpenFile3
[
]
mac
tag
"
[
16
.
1
]
Open
File
"
[
+
]
CustomWin
N1881
[
]
mac
tag
"
[
18
.
8
]
#
1
"
[
+
]
CustomWin
OpenFile4
[
]
mac
tag
"
[
OwnerDraw
]
Open
File
"
[
+
]
window
ChildWin
JavaTMTechnologyHomePage
[
]
tag
"
Java
(
TM
)
Technology
Home
Page
*
"
[
]
parent
Apprunner
[
+
]
PushButton
PushButton1
[
]
tag
"
#
1
"
[
+
]
TextField
TextField1
[
]
tag
"
#
1
"
[
+
]
CustomWin
N2423
[
]
mac
tag
"
[
24
.
2
]
#
3
"
[
+
]
CustomWin
N2421
[
]
mac
tag
"
[
24
.
2
]
#
1
"
[
+
]
CustomWin
N2422
[
]
mac
tag
"
[
24
.
2
]
#
2
"
[
+
]
TextField
TextField2
[
]
tag
"
#
2
"
[
-
]
/
/
window
MainWin
Apprunner
[
]
/
/
tag
"
apprunner
"
[
-
]
/
/
Menu
File
[
]
/
/
tag
"
File
"
[
+
]
/
/
MenuItem
NewBrowserWindow
[
]
/
/
tag
"
New
Browser
Window
"
[
+
]
/
/
MenuItem
New
[
]
/
/
tag
"
New
"
[
+
]
/
/
MenuItem
Open
[
]
/
/
tag
"
Open
"
[
+
]
/
/
MenuItem
SendPage
[
]
/
/
tag
"
Send
Page
"
[
+
]
/
/
MenuItem
EditPage
[
]
/
/
tag
"
Edit
Page
"
[
+
]
/
/
MenuItem
Offline
[
]
/
/
tag
"
Offline
"
[
+
]
/
/
MenuItem
PrintSetup
[
]
/
/
tag
"
Print
Setup
"
[
+
]
/
/
MenuItem
PrintPreview
[
]
/
/
tag
"
Print
Preview
"
[
+
]
/
/
MenuItem
Print
[
]
/
/
tag
"
Print
"
[
+
]
/
/
MenuItem
Close
[
]
/
/
tag
"
.
Close
"
[
+
]
/
/
MenuItem
Quit
[
]
/
/
tag
"
Quit
"
[
+
]
/
/
Menu
Edit
[
]
/
/
tag
"
Edit
"
[
+
]
/
/
MenuItem
Undo
[
]
/
/
tag
"
Undo
"
[
+
]
/
/
MenuItem
Redo
[
]
/
/
tag
"
Redo
"
[
+
]
/
/
MenuItem
Cut
[
]
/
/
tag
"
Cut
"
[
+
]
/
/
MenuItem
Copy
[
]
/
/
tag
"
Copy
"
[
+
]
/
/
MenuItem
Paste
[
]
/
/
tag
"
Paste
"
[
+
]
/
/
MenuItem
Delete
[
]
/
/
tag
"
Delete
"
[
+
]
/
/
MenuItem
Wallet
[
]
/
/
tag
"
Wallet
"
[
+
]
/
/
MenuItem
SelectAll
[
]
/
/
tag
"
Select
All
"
[
+
]
/
/
MenuItem
Preferences
[
]
/
/
tag
"
Preferences
"
[
+
]
/
/
Menu
View
[
]
/
/
tag
"
View
"
[
+
]
/
/
MenuItem
Toolbars
[
]
/
/
tag
"
Toolbars
"
[
+
]
/
/
MenuItem
Sidebar
[
]
/
/
tag
"
Sidebar
"
[
+
]
/
/
MenuItem
EnlargeTextSize
[
]
/
/
tag
"
Enlarge
Text
Size
"
[
+
]
/
/
MenuItem
ReduceTextSize
[
]
/
/
tag
"
Reduce
Text
Size
"
[
+
]
/
/
MenuItem
UseStylesheet
[
]
/
/
tag
"
Use
Stylesheet
"
[
+
]
/
/
MenuItem
Reload
[
]
/
/
tag
"
Reload
"
[
+
]
/
/
MenuItem
ShowImages
[
]
/
/
tag
"
Show
Images
"
[
+
]
/
/
MenuItem
Stop
[
]
/
/
tag
"
Stop
"
[
+
]
/
/
MenuItem
PageSource
[
]
/
/
tag
"
Page
Source
"
[
+
]
/
/
MenuItem
PageInfo
[
]
/
/
tag
"
Page
Info
"
[
+
]
/
/
MenuItem
Translate
[
]
/
/
tag
"
Translate
"
[
+
]
/
/
Menu
DefaultCharacterSet
[
]
/
/
tag
"
Default
Character
Set
"
[
+
]
/
/
MenuItem
ISOLatin1ISO88591
[
]
/
/
tag
"
ISO
Latin
1
(
ISO
-
8859
-
1
)
"
[
+
]
/
/
MenuItem
ISOLatin2ISO88592
[
]
/
/
tag
"
ISO
Latin
2
(
ISO
-
8859
-
2
)
"
[
+
]
/
/
MenuItem
ISOLatin3ISO88593
[
]
/
/
tag
"
ISO
Latin
3
(
ISO
-
8859
-
3
)
"
[
+
]
/
/
MenuItem
ISOLatin4ISO88594
[
]
/
/
tag
"
ISO
Latin
4
(
ISO
-
8859
-
4
)
"
[
+
]
/
/
MenuItem
ISOLatin5ISO88599
[
]
/
/
tag
"
ISO
Latin
5
(
ISO
-
8859
-
9
)
"
[
+
]
/
/
MenuItem
ISOLatin8ISO885914
[
]
/
/
tag
"
ISO
Latin
8
(
ISO
-
8859
-
14
)
"
[
+
]
/
/
MenuItem
ISOLatin9ISO885915
[
]
/
/
tag
"
ISO
Latin
9
(
ISO
-
8859
-
15
)
"
[
+
]
/
/
MenuItem
WindowsLatin2Windows1250
[
]
/
/
tag
"
Windows
Latin2
(
windows
-
1250
)
"
[
+
]
/
/
MenuItem
WindowsLatin1Windows1252
[
]
/
/
tag
"
Windows
Latin
1
(
windows
-
1252
)
"
[
+
]
/
/
MenuItem
WindowsLatin5Windows1254
[
]
/
/
tag
"
Windows
Latin
5
(
windows
-
1254
)
"
[
+
]
/
/
MenuItem
WindowsBalticRimWindows12
[
]
/
/
tag
"
Windows
Baltic
Rim
(
windows
-
1257
)
"
[
+
]
/
/
MenuItem
MacintoshRoman
[
]
/
/
tag
"
Macintosh
Roman
"
[
+
]
/
/
MenuItem
MacintoshCentralEuropean
[
]
/
/
tag
"
Macintosh
Central
European
"
[
+
]
/
/
MenuItem
MacintoshTurkish
[
]
/
/
tag
"
Macintosh
Turkish
"
[
+
]
/
/
MenuItem
MacintoshCroatian
[
]
/
/
tag
"
Macintosh
Croatian
"
[
+
]
/
/
MenuItem
MacintoshRomanian
[
]
/
/
tag
"
Macintosh
Romanian
"
[
+
]
/
/
MenuItem
MacintoshIcelandic
[
]
/
/
tag
"
Macintosh
Icelandic
"
[
+
]
/
/
MenuItem
JapaneseJISISO2022JP
[
]
/
/
tag
"
Japanese
JIS
(
ISO
-
2022
-
JP
)
"
[
+
]
/
/
MenuItem
JapaneseShift_JIS
[
]
/
/
tag
"
Japanese
(
Shift_JIS
)
"
[
+
]
/
/
MenuItem
JapaneseEUCJP
[
]
/
/
tag
"
Japanese
(
EUC
-
JP
)
"
[
+
]
/
/
MenuItem
TraditionalChineseBig5
[
]
/
/
tag
"
Traditional
Chinese
(
Big5
)
"
[
+
]
/
/
MenuItem
TraditionalChineseEUCTW
[
]
/
/
tag
"
Traditional
Chinese
(
EUC
-
TW
)
"
[
+
]
/
/
MenuItem
SimplifiedChineseGB2312
[
]
/
/
tag
"
Simplified
Chinese
(
GB2312
)
"
[
+
]
/
/
MenuItem
KoreanEUCKR
[
]
/
/
tag
"
Korean
(
EUC
-
KR
)
"
[
+
]
/
/
MenuItem
UTF8
[
]
/
/
tag
"
UTF
-
8
"
[
+
]
/
/
MenuItem
ISOCyrillicISO88595
[
]
/
/
tag
"
ISO
Cyrillic
(
ISO
-
8859
-
5
)
"
[
+
]
/
/
MenuItem
WindowsCyrillicWindows1251
[
]
/
/
tag
"
Windows
Cyrillic
(
windows
-
1251
)
"
[
+
]
/
/
MenuItem
MacintoshCyrillic
[
]
/
/
tag
"
Macintosh
Cyrillic
"
[
+
]
/
/
MenuItem
MacintoshUkrainian
[
]
/
/
tag
"
Macintosh
Ukrainian
"
[
+
]
/
/
MenuItem
RussianKOI8R
[
]
/
/
tag
"
Russian
(
KOI8
-
R
)
"
[
+
]
/
/
MenuItem
UkrainianKOI8U
[
]
/
/
tag
"
Ukrainian
(
KOI8
-
U
)
"
[
+
]
/
/
MenuItem
ISOGreekISO88597
[
]
/
/
tag
"
ISO
Greek
(
ISO
-
8859
-
7
)
"
[
+
]
/
/
MenuItem
WindowsGreekWindows1253
[
]
/
/
tag
"
Windows
Greek
(
windows
-
1253
)
"
[
+
]
/
/
MenuItem
MacintoshGreek
[
]
/
/
tag
"
Macintosh
Greek
"
[
+
]
/
/
MenuItem
WindowsVietnameseWindows12
[
]
/
/
tag
"
Windows
Vietnamese
(
windows
-
1258
)
"
[
+
]
/
/
MenuItem
VietnameseTCVN5712
[
]
/
/
tag
"
Vietnamese
(
TCVN5712
)
"
[
+
]
/
/
MenuItem
VietnameseVISCII
[
]
/
/
tag
"
Vietnamese
(
VISCII
)
"
[
+
]
/
/
MenuItem
VietnameseVPS
[
]
/
/
tag
"
Vietnamese
(
VPS
)
"
[
+
]
/
/
MenuItem
ThaiTIS620
[
]
/
/
tag
"
Thai
(
TIS
-
620
)
"
[
+
]
/
/
MenuItem
ArmenianARMSCII8
[
]
/
/
tag
"
Armenian
(
ARMSCII
-
8
)
"
[
+
]
/
/
Menu
Search
[
]
/
/
tag
"
Search
"
[
+
]
/
/
MenuItem
FindOnThisPage
[
]
/
/
tag
"
Find
On
This
page
"
[
+
]
/
/
MenuItem
FindAgain
[
]
/
/
tag
"
Find
Again
"
[
+
]
/
/
MenuItem
SearchParentItem
[
]
/
/
tag
"
Search
Parent
Item
"
[
+
]
/
/
MenuItem
SearchParent2Item
[
]
/
/
tag
"
Search
Parent2
Item
"
[
+
]
/
/
MenuItem
AppSpecific1
[
]
/
/
tag
"
App
Specific
[
1
]
"
[
+
]
/
/
MenuItem
AppSpecific2
[
]
/
/
tag
"
App
Specific
[
2
]
"
[
+
]
/
/
MenuItem
SearchTheInternet
[
]
/
/
tag
"
Search
The
Internet
"
[
+
]
/
/
MenuItem
SearchAllMail
[
]
/
/
tag
"
Search
All
Mail
"
[
+
]
/
/
MenuItem
SearchBookmarks
[
]
/
/
tag
"
Search
Bookmarks
"
[
+
]
/
/
MenuItem
SearchPeople
[
]
/
/
tag
"
Search
People
"
[
+
]
/
/
MenuItem
SearchOnThisComputer
[
]
/
/
tag
"
Search
On
This
Computer
"
[
+
]
/
/
Menu
Go
[
]
/
/
tag
"
Go
"
[
+
]
/
/
MenuItem
Back
[
]
/
/
tag
"
Back
"
[
+
]
/
/
MenuItem
Forward
[
]
/
/
tag
"
Forward
"
[
+
]
/
/
MenuItem
Home
[
]
/
/
tag
"
Home
"
[
+
]
/
/
MenuItem
PreviousSite1
[
]
/
/
tag
"
Previous
Site
1
"
[
+
]
/
/
MenuItem
PreviousSite2
[
]
/
/
tag
"
Previous
Site
2
"
[
+
]
/
/
MenuItem
PreviousSiteN
[
]
/
/
tag
"
Previous
Site
n
"
[
+
]
/
/
Menu
Bookmarks
[
]
/
/
tag
"
Bookmarks
"
[
+
]
/
/
MenuItem
AddCurrentPage
[
]
/
/
tag
"
Add
Current
Page
"
[
+
]
/
/
MenuItem
ManageBookmarks
[
]
/
/
tag
"
Manage
Bookmarks
"
[
+
]
/
/
MenuItem
SampleFTPURLs
[
]
/
/
tag
"
Sample
FTP
URLs
"
[
+
]
/
/
MenuItem
SampleSmartFindQueries
[
]
/
/
tag
"
Sample
SmartFind
queries
"
[
+
]
/
/
MenuItem
PersonalToolbarFolder
[
]
/
/
tag
"
Personal
Toolbar
Folder
"
[
+
]
/
/
MenuItem
N1
[
]
/
/
tag
"
-
-
-
-
-
[
1
]
"
[
+
]
/
/
MenuItem
Search
[
]
/
/
tag
"
Search
"
[
+
]
/
/
MenuItem
BusinessAndFinance
[
]
/
/
tag
"
Business
and
Finance
"
[
+
]
/
/
MenuItem
ComputersAndInternet
[
]
/
/
tag
"
Computers
and
Internet
"
[
+
]
/
/
MenuItem
Directories
[
]
/
/
tag
"
Directories
"
[
+
]
/
/
MenuItem
EntertainmentAndLifestyle
[
]
/
/
tag
"
Entertainment
and
Lifestyle
"
[
+
]
/
/
MenuItem
NewsAndSports
[
]
/
/
tag
"
News
and
Sports
"
[
+
]
/
/
MenuItem
ShoppingAndClassifieds
[
]
/
/
tag
"
Shopping
and
Classifieds
"
[
+
]
/
/
MenuItem
TravelAndLeisure
[
]
/
/
tag
"
Travel
and
Leisure
"
[
+
]
/
/
MenuItem
MacintoshResources
[
]
/
/
tag
"
Macintosh
Resources
"
[
+
]
/
/
MenuItem
AAAURLsWithNoRedirection
[
]
/
/
tag
"
AAA
URLs
with
no
redirection
"
[
+
]
/
/
MenuItem
N2
[
]
/
/
tag
"
-
-
-
-
-
[
2
]
"
[
+
]
/
/
MenuItem
PersonalBookmarks
[
]
/
/
tag
"
Personal
Bookmarks
"
[
+
]
/
/
MenuItem
ImportedIEFavorites
[
]
/
/
tag
"
Imported
IE
Favorites
"
[
+
]
/
/
MenuItem
NetcenterX
FS
[
]
/
/
tag
"
Netcenter
x
FS
?
"
[
+
]
/
/
Menu
Tasks
[
]
/
/
tag
"
Tasks
"
[
+
]
/
/
MenuItem
Navigator
[
]
/
/
tag
"
Navigator
"
[
+
]
/
/
MenuItem
Messenger
[
]
/
/
tag
"
Messenger
"
[
+
]
/
/
MenuItem
Editor
[
]
/
/
tag
"
Editor
"
[
+
]
/
/
MenuItem
ManageHistory
[
]
/
/
tag
"
Manage
History
"
[
+
]
/
/
MenuItem
Chat
[
]
/
/
tag
"
Chat
"
[
+
]
/
/
MenuItem
ShoppingCart
[
]
/
/
tag
"
Shopping
Cart
"
[
+
]
/
/
MenuItem
ServicesA
[
]
/
/
tag
"
Services
A
"
[
+
]
/
/
MenuItem
ServicesB
[
]
/
/
tag
"
Services
B
"
[
+
]
/
/
MenuItem
ServicesC
[
]
/
/
tag
"
Services
C
"
[
+
]
/
/
MenuItem
ServicesD
[
]
/
/
tag
"
Services
D
"
[
+
]
/
/
MenuItem
Tools
[
]
/
/
tag
"
Tools
"
[
+
]
/
/
MenuItem
SecurityInfo
[
]
/
/
tag
"
Security
Info
"
[
+
]
/
/
MenuItem
Window1
[
]
/
/
tag
"
Window
1
"
[
+
]
/
/
MenuItem
Window2
[
]
/
/
tag
"
Window
2
"
[
+
]
/
/
MenuItem
Window3
[
]
/
/
tag
"
Window
3
"
[
+
]
/
/
Menu
Help
[
]
/
/
tag
"
Help
"
[
+
]
/
/
MenuItem
HelpContents
[
]
/
/
tag
"
Help
Contents
"
[
+
]
/
/
MenuItem
HowToTutorial
[
]
/
/
tag
"
How
To
Tutorial
"
[
+
]
/
/
MenuItem
HelpChannel
[
]
/
/
tag
"
Help
Channel
"
[
+
]
/
/
MenuItem
SoftwareUpdates
[
]
/
/
tag
"
Software
Updates
"
[
+
]
/
/
MenuItem
TechnicalSupport
[
]
/
/
tag
"
Technical
Support
"
[
+
]
/
/
MenuItem
ReleaseNotes
[
]
/
/
tag
"
Release
Notes
"
[
+
]
/
/
MenuItem
AboutCommunicatorPrototype
[
]
/
/
tag
"
About
Communicator
Prototype
"
[
+
]
/
/
Menu
Debug
[
]
/
/
tag
"
Debug
"
[
+
]
/
/
MenuItem
Verification
[
]
/
/
tag
"
Verification
"
[
+
]
/
/
MenuItem
ViewerDemos
[
]
/
/
tag
"
Viewer
Demos
"
[
+
]
/
/
MenuItem
XPToolkit
[
]
/
/
tag
"
XPToolkit
"
[
+
]
window
ChildWin
TestPageForHTML40Elemen
[
]
tag
"
Test
Page
for
:
HTML
4
.
0
elements
*
"
[
]
parent
Apprunner
[
+
]
CustomWin
ScrollBar
[
]
mac
tag
"
[
24
.
2
]
#
1
"
[
+
]
CustomWin
N2423
[
]
mac
tag
"
[
24
.
2
]
#
3
"
[
+
]
CustomWin
N2422
[
]
mac
tag
"
[
24
.
2
]
#
2
"
[
+
]
CustomWin
N2424
[
]
mac
tag
"
[
24
.
2
]
#
4
"
[
+
]
TextField
TextField1
[
]
tag
"
#
1
"
[
+
]
window
ChildWin
CreateProfileWizard
[
]
tag
"
CreateProfile
Wizard
*
"
[
]
parent
Apprunner
[
-
]
Setup
(
)
[
]
CreateProfileWizard
.
Size
(
560
518
)
[
]
CreateProfileWizard
.
Next
.
Click
(
)
[
]
sleep
(
2
)
[
]
CreateProfileWizard
.
TypeKeys
(
"
<
Tab
>
"
)
[
]
CreateProfileWizard
.
TypeKeys
(
"
iqasmoketest
"
)
[
]
[
]
CreateProfileWizard
.
Next
.
Click
(
)
[
]
sleep
(
2
)
[
]
CreateProfileWizard
.
TypeKeys
(
"
<
Tab
>
"
)
[
]
CreateProfileWizard
.
TypeKeys
(
"
sUserName
"
)
[
]
CreateProfileWizard
.
TypeKeys
(
"
<
Tab
>
"
)
[
]
CreateProfileWizard
.
TypeKeys
(
"
{
sUserName
}
{
sMailServer
}
"
)
[
]
CreateProfileWizard
.
Next
.
Click
(
)
[
]
sleep
(
2
)
[
]
CreateProfileWizard
.
TypeKeys
(
"
<
Tab
>
"
)
[
]
CreateProfileWizard
.
TypeKeys
(
sMailServer
)
[
]
CreateProfileWizard
.
Finish
.
Click
(
)
[
]
sleep
(
2
)
[
-
]
CustomWin
Next
[
-
]
Click
(
)
[
]
CreateProfileWizard
.
Click
(
1
pNext
.
x
pNext
.
y
)
[
-
]
CustomWin
Prev
[
-
]
Click
(
)
[
]
CreateProfileWizard
.
Click
(
1
pPrev
.
x
pPrev
.
y
)
[
-
]
CustomWin
Finish
[
-
]
Click
(
)
[
]
CreateProfileWizard
.
Click
(
1
pNext
.
x
pNext
.
y
)
[
+
]
TextField
TextField2
[
]
tag
"
#
2
"
[
+
]
TextField
TextField1
[
]
tag
"
#
1
"
[
-
]
CustomWin
N2421
[
]
mac
tag
"
[
24
.
2
]
#
1
"
[
-
]
window
ChildWin
Messenger
[
]
tag
"
Messenger
"
[
]
parent
Apprunner
[
]
[
]
POINT
pGetMessage
=
{
40
25
}
[
]
POINT
pNewMessage
=
{
80
25
}
[
]
POINT
pReply
=
{
120
25
}
[
]
POINT
pForward
=
{
160
25
}
[
]
POINT
pDelete
=
{
200
25
}
[
]
[
]
[
-
]
SetActive
(
)
[
]
Apprunner
.
SetActive
(
)
[
]
Apprunner
.
Tasks
.
Messenger
.
Pick
(
)
[
-
]
NewMessage
(
)
[
]
Messenger
.
Click
(
1
pNewMessage
.
x
pNewMessage
.
y
)
[
-
]
GetMessage
(
)
[
]
Messenger
.
Click
(
1
pGetMessage
.
x
pGetMessage
.
y
)
[
-
]
Reply
(
)
[
]
Messenger
.
Click
(
1
pReply
.
x
pReply
.
y
)
[
-
]
Forward
(
)
[
]
Messenger
.
Click
(
1
pForward
.
x
pForward
.
y
)
[
-
]
Delete
(
)
[
]
Messenger
.
Click
(
1
pDelete
.
x
pDelete
.
y
)
[
+
]
CustomWin
N2421
[
]
mac
tag
"
[
24
.
2
]
#
1
"
[
+
]
CustomWin
N2422
[
]
mac
tag
"
[
24
.
2
]
#
2
"
[
+
]
window
ChildWin
MessageCompose
[
]
tag
"
_nameless_
"
[
]
parent
Apprunner
[
]
[
]
POINT
pSend
=
{
27
19
}
[
]
POINT
pQuote
=
{
59
21
}
[
]
POINT
pAddress
=
{
101
21
}
[
]
POINT
pAttach
=
{
140
22
}
[
]
POINT
pSpelling
=
{
181
19
}
[
]
POINT
pSave
=
{
220
21
}
[
]
POINT
pStop
=
{
253
20
}
[
]
[
-
]
Send
(
)
[
]
MessageCompose
.
Click
(
1
pSend
.
x
pSend
.
y
)
[
-
]
Quote
(
)
[
]
MessageCompose
.
Click
(
1
pQuote
.
x
pQuote
.
y
)
[
-
]
Address
(
)
[
]
MessageCompose
.
Click
(
1
pAddress
.
x
pAddress
.
y
)
[
-
]
Attach
(
)
[
]
MessageCompose
.
Click
(
1
pAttach
.
x
pAttach
.
y
)
[
-
]
Spelling
(
)
[
]
MessageCompose
.
Click
(
1
pSpelling
.
x
pSpelling
.
y
)
[
-
]
Save
(
)
[
]
MessageCompose
.
Click
(
1
pSave
.
x
pSave
.
y
)
[
-
]
Stop
(
)
[
]
MessageCompose
.
Click
(
1
pStop
.
x
pStop
.
y
)
[
+
]
CustomWin
N2502
[
]
mac
tag
"
[
25
.
0
]
#
2
"
[
+
]
CustomWin
N2501
[
]
mac
tag
"
[
25
.
0
]
#
1
"
[
+
]
TextField
Subject
[
]
tag
"
#
5
"
[
+
]
TextField
NewsGroups
[
]
tag
"
#
4
"
[
+
]
TextField
BCC
[
]
tag
"
#
3
"
[
+
]
TextField
CC
[
]
tag
"
#
2
"
[
+
]
TextField
To
[
]
tag
"
#
1
"
[
+
]
window
ChildWin
OpenLocation
[
]
tag
"
Open
Location
"
[
]
parent
Apprunner
[
+
]
CheckBox
CheckBox1
[
]
tag
"
#
1
"
[
+
]
TextField
TextField1
[
]
tag
"
#
1
"
[
+
]
CustomWin
SelectFile
[
-
]
Click
(
)
[
]
OpenLocation
.
Click
(
1
325
60
)
[
+
]
CustomWin
Open
[
-
]
Click
(
)
[
]
OpenLocation
.
Click
(
1
200
115
)
[
+
]
CustomWin
Cancel
[
-
]
Click
(
)
[
]
OpenLocation
.
Click
(
1
300
115
)
[
+
]
CustomWin
Help
[
-
]
Click
(
)
[
]
OpenLocation
.
Click
(
1
350
115
)
[
-
]
window
MainWin
Ender
[
]
tag
"
apprunner
"
[
+
]
Menu
File
[
]
tag
"
File
"
[
+
]
MenuItem
New
[
]
tag
"
New
"
[
+
]
MenuItem
Open
[
]
tag
"
Open
"
[
+
]
MenuItem
Close
[
]
tag
"
.
Close
"
[
+
]
MenuItem
Save
[
]
tag
"
Save
"
[
+
]
MenuItem
SaveAs
[
]
tag
"
Save
As
"
[
+
]
MenuItem
PrintSetup
[
]
tag
"
.
Print
Setup
"
[
+
]
MenuItem
PrintPreview
[
]
tag
"
Print
Preview
"
[
+
]
MenuItem
Print
[
]
tag
"
.
Print
"
[
+
]
MenuItem
Quit
[
]
tag
"
Quit
"
[
+
]
Menu
Edit
[
]
tag
"
Edit
"
[
+
]
MenuItem
Undo
[
]
tag
"
Undo
"
[
+
]
MenuItem
Redo
[
]
tag
"
Redo
"
[
+
]
MenuItem
Cut
[
]
tag
"
Cut
"
[
+
]
MenuItem
Copy
[
]
tag
"
Copy
"
[
+
]
MenuItem
Paste
[
]
tag
"
Paste
"
[
+
]
MenuItem
PasteAsQuotation
[
]
tag
"
Paste
as
Quotation
"
[
+
]
MenuItem
Clear
[
]
tag
"
.
Clear
"
[
+
]
MenuItem
SelectAll
[
]
tag
"
Select
All
"
[
+
]
MenuItem
Find
[
]
tag
"
Find
"
[
+
]
MenuItem
FindAgain
[
]
tag
"
Find
Again
"
[
+
]
Menu
View
[
]
tag
"
View
"
[
+
]
MenuItem
HideCompositionToolbar
[
]
tag
"
.
Hide
Composition
Toolbar
"
[
+
]
MenuItem
HideFormatToolbar
[
]
tag
"
.
Hide
Format
Toolbar
"
[
+
]
Menu
Insert
[
]
tag
"
Insert
"
[
+
]
MenuItem
Link
[
]
tag
"
Link
"
[
+
]
MenuItem
Target
[
]
tag
"
.
Target
"
[
+
]
MenuItem
Image
[
]
tag
"
Image
"
[
+
]
MenuItem
HorizontalLine
[
]
tag
"
.
Horizontal
Line
"
[
+
]
MenuItem
Table
[
]
tag
"
.
Table
"
[
+
]
MenuItem
HTMLTag
[
]
tag
"
.
HTML
Tag
"
[
+
]
MenuItem
LineBreak
[
]
tag
"
.
Line
Break
"
[
+
]
MenuItem
BreakBelowImageS
[
]
tag
"
.
Break
Below
Image
(
s
)
"
[
+
]
Menu
Format
[
]
tag
"
Format
"
[
+
]
MenuItem
FontFace
[
]
tag
"
Font
Face
"
[
+
]
MenuItem
Size
[
]
tag
"
Size
"
[
+
]
MenuItem
Style
[
]
tag
"
Style
"
[
+
]
MenuItem
Color
[
]
tag
"
.
Color
"
[
+
]
MenuItem
RemoveAllStyleS
[
]
tag
"
Remove
All
Style
(
s
)
"
[
+
]
MenuItem
ParagraphHeading
[
]
tag
"
Paragraph
?
Heading
"
[
-
]
Menu
Tools
[
]
tag
"
Tools
"
[
+
]
MenuItem
NewBrowserWindow
[
]
tag
"
New
Browser
Window
"
[
+
]
MenuItem
NewPlaintextEditor
[
]
tag
"
New
Plaintext
Editor
"
[
+
]
MenuItem
SpellCheck
[
]
tag
"
Spell
Check
"
[
+
]
MenuItem
SetFocus
[
]
tag
"
Set
Focus
"
[
+
]
Menu
Debug
[
]
tag
"
Debug
"
[
+
]
MenuItem
OutputText
[
]
tag
"
Output
Text
"
[
+
]
MenuItem
OutputHTML
[
]
tag
"
Output
HTML
"
[
+
]
MenuItem
InsertText
[
]
tag
"
Insert
Text
"
[
+
]
MenuItem
TestSelection
[
]
tag
"
Test
Selection
"
[
+
]
MenuItem
TestDocument
[
]
tag
"
Test
Document
"
[
+
]
MenuItem
RunUnitTests
[
]
tag
"
Run
Unit
Tests
"
[
+
]
Menu
Help
[
]
tag
"
Help
"
[
+
]
MenuItem
About
[
]
tag
"
.
About
"
[
+
]
window
ChildWin
EnderHTMLTestPage
[
]
tag
"
Ender
HTML
Test
Page
"
[
]
parent
Apprunner
[
-
]
CustomWin
Bold
[
-
]
Click
(
)
[
]
EnderHTMLTestPage
.
Click
(
1
239
11
)
[
-
]
CustomWin
Italic
[
-
]
Click
(
)
[
]
EnderHTMLTestPage
.
Click
(
1
268
11
)
[
-
]
CustomWin
Underline
[
-
]
Click
(
)
[
]
EnderHTMLTestPage
.
Click
(
1
297
11
)
[
+
]
ScrollBar
ScrollBar1
[
]
tag
"
#
1
"
[
+
]
/
/
window
ChildWin
MozillaQASmokeTests
[
]
/
/
tag
"
Mozilla
QA
Smoke
Tests
*
"
[
]
/
/
parent
Apprunner
[
+
]
/
/
ScrollBar
ScrollBar2
[
]
/
/
tag
"
#
2
"
[
+
]
/
/
ScrollBar
ScrollBar1
[
]
/
/
tag
"
#
1
"
[
-
]
/
/
CustomWin
N1701
[
]
/
/
mac
tag
"
[
17
.
0
]
#
1
"
[
-
]
/
/
window
MainWin
Apprunner
[
]
/
/
tag
"
apprunner
"
[
+
]
/
/
Menu
File
[
]
/
/
tag
"
File
"
[
+
]
/
/
MenuItem
New
[
]
/
/
tag
"
New
"
[
+
]
/
/
MenuItem
Open
[
]
/
/
tag
"
Open
"
[
+
]
/
/
MenuItem
Close
[
]
/
/
tag
"
.
Close
"
[
+
]
/
/
MenuItem
Save
[
]
/
/
tag
"
Save
"
[
+
]
/
/
MenuItem
SaveAs
[
]
/
/
tag
"
Save
As
"
[
+
]
/
/
MenuItem
PrintSetup
[
]
/
/
tag
"
.
Print
Setup
"
[
+
]
/
/
MenuItem
PrintPreview
[
]
/
/
tag
"
Print
Preview
"
[
+
]
/
/
MenuItem
Print
[
]
/
/
tag
"
.
Print
"
[
+
]
/
/
MenuItem
Quit
[
]
/
/
tag
"
Quit
"
[
+
]
/
/
Menu
Edit
[
]
/
/
tag
"
Edit
"
[
+
]
/
/
MenuItem
Undo
[
]
/
/
tag
"
Undo
"
[
+
]
/
/
MenuItem
Redo
[
]
/
/
tag
"
Redo
"
[
+
]
/
/
MenuItem
Cut
[
]
/
/
tag
"
Cut
"
[
+
]
/
/
MenuItem
Copy
[
]
/
/
tag
"
Copy
"
[
+
]
/
/
MenuItem
Paste
[
]
/
/
tag
"
Paste
"
[
+
]
/
/
MenuItem
PasteAsQuotation
[
]
/
/
tag
"
Paste
as
Quotation
"
[
+
]
/
/
MenuItem
Clear
[
]
/
/
tag
"
.
Clear
"
[
+
]
/
/
MenuItem
SelectAll
[
]
/
/
tag
"
Select
All
"
[
+
]
/
/
MenuItem
Find
[
]
/
/
tag
"
Find
"
[
+
]
/
/
MenuItem
FindAgain
[
]
/
/
tag
"
Find
Again
"
[
+
]
/
/
Menu
View
[
]
/
/
tag
"
View
"
[
+
]
/
/
MenuItem
HideCompositionToolbar
[
]
/
/
tag
"
.
Hide
Composition
Toolbar
"
[
+
]
/
/
MenuItem
HideFormatToolbar
[
]
/
/
tag
"
.
Hide
Format
Toolbar
"
[
+
]
/
/
Menu
Insert
[
]
/
/
tag
"
Insert
"
[
+
]
/
/
MenuItem
Link
[
]
/
/
tag
"
Link
"
[
+
]
/
/
MenuItem
Target
[
]
/
/
tag
"
.
Target
"
[
+
]
/
/
MenuItem
Image
[
]
/
/
tag
"
Image
"
[
+
]
/
/
MenuItem
HorizontalLine
[
]
/
/
tag
"
Horizontal
Line
"
[
+
]
/
/
MenuItem
Table
[
]
/
/
tag
"
.
Table
"
[
+
]
/
/
MenuItem
HTMLTag
[
]
/
/
tag
"
.
HTML
Tag
"
[
+
]
/
/
MenuItem
LineBreak
[
]
/
/
tag
"
.
Line
Break
"
[
+
]
/
/
MenuItem
BreakBelowImageS
[
]
/
/
tag
"
.
Break
Below
Image
(
s
)
"
[
+
]
/
/
Menu
Format
[
]
/
/
tag
"
Format
"
[
+
]
/
/
MenuItem
FontFace
[
]
/
/
tag
"
Font
Face
"
[
+
]
/
/
MenuItem
Size
[
]
/
/
tag
"
Size
"
[
+
]
/
/
MenuItem
Style
[
]
/
/
tag
"
Style
"
[
+
]
/
/
MenuItem
TextColor
[
]
/
/
tag
"
Text
Color
"
[
+
]
/
/
MenuItem
BackgroundColor
[
]
/
/
tag
"
Background
Color
"
[
+
]
/
/
MenuItem
RemoveAllStyleS
[
]
/
/
tag
"
Remove
All
Style
(
s
)
"
[
+
]
/
/
MenuItem
RemoveLinkS
[
]
/
/
tag
"
Remove
Link
(
s
)
"
[
+
]
/
/
MenuItem
Heading
[
]
/
/
tag
"
Heading
"
[
+
]
/
/
MenuItem
Paragraph
[
]
/
/
tag
"
Paragraph
"
[
-
]
/
/
Menu
Tools
[
]
/
/
tag
"
Tools
"
[
+
]
/
/
MenuItem
NewBrowserWindow
[
]
/
/
tag
"
New
Browser
Window
"
[
+
]
/
/
MenuItem
NewPlaintextEditor
[
]
/
/
tag
"
New
Plaintext
Editor
"
[
+
]
/
/
MenuItem
SpellCheck
[
]
/
/
tag
"
Spell
Check
"
[
+
]
/
/
MenuItem
SetFocus
[
]
/
/
tag
"
Set
Focus
"
[
+
]
/
/
Menu
Debug
[
]
/
/
tag
"
Debug
"
[
+
]
/
/
MenuItem
OutputText
[
]
/
/
tag
"
Output
Text
"
[
+
]
/
/
MenuItem
OutputHTML
[
]
/
/
tag
"
Output
HTML
"
[
+
]
/
/
MenuItem
InsertText
[
]
/
/
tag
"
Insert
Text
"
[
+
]
/
/
MenuItem
TestSelection
[
]
/
/
tag
"
Test
Selection
"
[
+
]
/
/
MenuItem
TestDocument
[
]
/
/
tag
"
Test
Document
"
[
+
]
/
/
MenuItem
RunUnitTests
[
]
/
/
tag
"
Run
Unit
Tests
"
[
+
]
/
/
MenuItem
StartJournal
[
]
/
/
tag
"
Start
Journal
"
[
+
]
/
/
MenuItem
StopJournal
[
]
/
/
tag
"
Stop
Journal
"
[
+
]
/
/
MenuItem
RunJournal
[
]
/
/
tag
"
Run
Journal
"
[
+
]
/
/
Menu
Help
[
]
/
/
tag
"
Help
"
[
+
]
/
/
MenuItem
About
[
]
/
/
tag
"
.
About
"
[
+
]
STRING
ReadMozillaHome
(
)
[
]
STRING
sLine
[
-
]
if
(
bDebug
=
=
true
)
[
]
sLine
=
"
{
SYS_GetDrive
(
)
}
:
mozilla
:
dist
:
viewer
"
[
-
]
else
[
]
HFILE
hIN
=
FileOpen
(
"
mozillahome
.
txt
"
FM_READ
)
[
]
FileReadLine
(
hIN
sLine
)
[
]
FileClose
(
hIN
)
[
]
return
sLine
[
+
]
window
ChildWin
CustomizeSidebar
[
]
tag
"
_nameless_
"
[
]
parent
Apprunner
[
+
]
CustomWin
N2421
[
]
mac
tag
"
[
24
.
2
]
#
1
"
[
+
]
CustomWin
N2201
[
]
mac
tag
"
[
22
.
0
]
#
1
"
[
]
B
B
B
B
A
A
B
A
B
B
B
B
B
B
B
B
B
B
B
B
A
A
A
A
A
A
A
A
A
A
A
A
A
A
A
A
A
A
A
B
B
B
B
B
B
B
A
B
A
B
B
B
B
A
B
B
B
5B
A
/
B
B
B
B
EB
A
A
A
B
H
Monaco
6
^
G
6
^
G
p
U
?
20
i
k
amasri
%
netscape
.
com
1
.
8
apFrame
.
inc
changed
Invoke
(
)
method
to
give
better
error
messages
changed
iBitmapWait
to
90
to
account
for
i18n
sites
changed
default
home
page
to
"
Navigator
Help
"
changed
sDir
to
full
path
from
relative
path
NOTE
:
must
be
changed
for
each
machine
it
runs
on
added
timeout
to
Apprunner
.
Invoke
(
)
H
apFrame
.
inc
1
.
8
-
kb
mozilla
/
tools
/
tests
/
mac
&
n
MWBB
"
MPSR
.
ckid
:
mcvs
F
A
T
Projector
Data
MacCVS
Version
ResourceTEXTQAP2
